## sentinels3/sdkconfig.defaults
```kconfig
# SENTINEL-S3 sdkconfig.defaults
# Target
CONFIG_IDF_TARGET="esp32s3"
# PSRAM Octal
CONFIG_ESP32S3_SPIRAM_SUPPORT=y
CONFIG_SPIRAM_MODE_OCT=y
CONFIG_SPIRAM_SPEED_80M=y
CONFIG_SPIRAM_MALLOC_ALWAYSINTERNAL=4096
# Flash 16MB
CONFIG_ESPTOOLPY_FLASHSIZE="16MB"
# USB CDC
CONFIG_USB_OTG_SUPPORTED=y
CONFIG_TINYUSB_CDC_ENABLED=y
# LVGL
CONFIG_LVGL_ENABLE=y
CONFIG_LV_COLOR_16_SWAP=y
# FATFS SD
CONFIG_FATFS_VFS_FAT_MOUNT_POINT="/sd"
CONFIG_FATFS_SDMMC_SUPPORT=y
# Wi-Fi + BLE desligados na Phase 0
CONFIG_BT_ENABLED=n
# Power management OFF
CONFIG_PM_ENABLE=n
CONFIG_FREERTOS_USE_TICKLESS_IDLE=n
# Watchdog
CONFIG_ESP_TASK_WDT_TIMEOUT_S=30
```
